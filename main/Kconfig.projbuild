## main/Kconfig.projbuild
```kconfig
menu "Vibe-RGB Configuration"

    config ESP_WIFI_SSID
        string "Provisioning AP SSID"
        default "ESP32-Vibe-RGB"
        help
            SSID used by the temporary SoftAP during first-time WiFi provisioning.

    config ESP_MAX_STA_CONN
        int "Maximal STA connections"
        default 4
        range 1 10
        help
            Max number of stations that can connect to the provisioning AP concurrently.

    config ESP_STA_TIMEOUT_MS
        int "STA connect timeout (ms)"
        default 15000
        range 3000 60000
        help
            Timeout waiting for STA to associate with the stored AP before falling
            back to clearing credentials and rebooting into provisioning mode.

endmenu
```

## sdkconfig.defaults
```kconfig
# ---- 目标芯片 ----
CONFIG_IDF_TARGET="esp32s3"

# ---- Flash ----
CONFIG_ESPTOOLPY_FLASHSIZE_16MB=y
CONFIG_ESPTOOLPY_FLASHSIZE="16MB"
CONFIG_ESPTOOLPY_FLASHMODE_QIO=y

# ---- PSRAM (WROOM-1-N16R8 = 8MB Octal PSRAM) ----
CONFIG_SPIRAM=y
CONFIG_SPIRAM_MODE_OCT=y
CONFIG_SPIRAM_SPEED_80M=y

# ---- 分区表（双 OTA + storage）----
CONFIG_PARTITION_TABLE_CUSTOM=y
CONFIG_PARTITION_TABLE_CUSTOM_FILENAME="partitions.csv"
CONFIG_PARTITION_TABLE_FILENAME="partitions.csv"

# ---- CPU / FreeRTOS ----
# 240MHz：FFT 性能需要
CONFIG_ESP_DEFAULT_CPU_FREQ_MHZ_240=y
CONFIG_FREERTOS_HZ=1000

# ---- HTTP Server ----
CONFIG_HTTPD_WS_SUPPORT=y
# 配网页面较大，增大 HTTP 缓冲区
CONFIG_HTTPD_MAX_REQ_HDR_LEN=1024
CONFIG_HTTPD_MAX_URI_LEN=512

# ---- WiFi / 网络 ----
CONFIG_LWIP_MAX_SOCKETS=16
```
